## SDKConfig.defaults
```kconfig
CONFIG_WIFI_SSID="Wokwi-GUEST"
CONFIG_WIFI_PASSWORD=""
CONFIG_MPU6050_ENABLED=y
CONFIG_MQTT_ENABLED=y
CONFIG_PARTITION_TABLE_CUSTOM=y
CONFIG_PARTITION_TABLE_CUSTOM_FILENAME="partitions.csv"
CONFIG_PARTITION_TABLE_OFFSET=0x8000
CONFIG_PARTITION_TABLE_CUSTOM_APP_SIZE=0x180000
CONFIG_LITTLEFS_ENABLED=y
CONFIG_NVS_ENABLED=y
```
